## board/toradex/apalis_imx6/Kconfig
```kconfig
if TARGET_APALIS_IMX6

config SYS_BOARD
	default "apalis_imx6"

config SYS_CONFIG_NAME
	default "apalis_imx6"

config SYS_CPU
	default "armv7"

config SYS_SOC
	default "mx6"

config SYS_VENDOR
	default "toradex"

config TDX_CFG_BLOCK
	default y

config TDX_HAVE_MMC
	default y

config TDX_CFG_BLOCK_DEV
	default "0"

config TDX_CFG_BLOCK_PART
	default "1"

# Toradex config block in eMMC, at the end of 1st "boot sector"
config TDX_CFG_BLOCK_OFFSET
	default "-512"

config TDX_CMD_IMX_MFGR
	bool "Enable factory testing commands for Toradex iMX 6 modules"
	help
	  This adds the commands
	    pf0100_otp_prog - Program the OTP fuses on the PMIC PF0100
	  If executed on already fused modules it doesn't change any fuse setting.
	default y

config TDX_APALIS_IMX6_V1_0
	bool "Apalis iMX6 V1.0 HW"
	help
	  Apalis iMX6 V1.0 HW has a different pinout for the UART.
	    The UARTs must be used in DCE mode, RTS/CTS are swapped and
	    thus unusable on standard carrier boards.
	    This option configures DCE mode unconditionally. Whithout this
	    option the config block stating V1.0 HW selects DCE mode,
	    otherwise the UARTs are configuered in DTE mode.
	default n

config TDX_APALIS_IMX6_BOOT_PART
	int "Partition number to use for boot filesystem"
	default 1
	help
	  The partition number to use for boot filesystem this is the
	  partition that typically contains boot.scr, DTBs, uImage etc.

config TDX_APALIS_IMX6_ROOT_PART
	int "Partition number to use for root filesystem"
	default 2
	help
	  The partition number to use for root filesystem this is the
	  partition that is typically specified with root=/dev/sdaX or
	  which gets converted into a root=PARTUUID=some_uuid.

source "board/toradex/common/Kconfig"

endif
```

## board/toradex/colibri_imx7/Kconfig
```kconfig
if TARGET_COLIBRI_IMX7

config SYS_BOARD
	default "colibri_imx7"

config SYS_VENDOR
	default "toradex"

config SYS_SOC
	default "mx7"

config SYS_CONFIG_NAME
	default "colibri_imx7"

menuconfig TRDX_CMD_IMX_MFGR
	bool "Enable factory testing commands for Toradex iMX 7[B modules"
	help
	  This adds the command
	    mfgr_fuse: OTP fusing during module production
	  If executed on already fused modules they don't change any fuse setting.
	default y

endif
```

## configs/apalis_imx6_defconfig
```kconfig
CONFIG_ARM=y
CONFIG_ARCH_MX6=y
CONFIG_TARGET_APALIS_IMX6=y
CONFIG_SYS_EXTRA_OPTIONS="IMX_CONFIG=board/toradex/apalis_imx6/apalis_imx6q.cfg,MX6Q,DDR_MB=1024"
CONFIG_SYS_PROMPT="Apalis iMX6 # "
CONFIG_SYS_CBSIZE=1024
CONFIG_SYS_MAXARGS=48
```

## configs/apalis_imx6_it_defconfig
```kconfig
CONFIG_ARM=y
CONFIG_ARCH_MX6=y
CONFIG_TARGET_APALIS_IMX6=y
CONFIG_SYS_EXTRA_OPTIONS="IMX_CONFIG=board/toradex/apalis_imx6/apalis_imx6q.cfg,MX6Q,DDR_MB=2048"
```

## configs/colibri_imx7_defconfig
```kconfig
CONFIG_SYS_EXTRA_OPTIONS="IMX_CONFIG=board/toradex/colibri_imx7/imximage.cfg,MX7D,IMX_NAND"
CONFIG_ARM=y
CONFIG_TARGET_COLIBRI_IMX7=y
CONFIG_SYS_MALLOC_F=y
CONFIG_SYS_MALLOC_F_LEN=0x400
CONFIG_DM=y
CONFIG_DM_THERMAL=y
```
